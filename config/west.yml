## config/west.yml
```yaml
manifest:
  remotes:
    - name: cormoran
      url-base: https://github.com/cormoran
    - name: badjeff    # <-- PMW3610
      url-base: https://github.com/badjeff
    - name: caksoylar  # <-- RGB LED
      url-base: https://github.com/caksoylar
    - name: takamaru-fpv  # <-- Battery level smoothing
      url-base: https://github.com/takamaru-fpv
    - name: NF-H       # <-- 自分のフォーク (zmk_keymap_layer_activate/deactivate 引数修正版)
      url-base: https://github.com/NF-H

  projects:
    # ZMK: DYA Studio 用カスタム RPC サブシステム付き cormoran fork
    - name: zmk
      remote: cormoran
      revision: e5397fd
      import: app/west.yml
    - name: zmk-feature-non-lipo-battery-management
      remote: takamaru-fpv
      revision: fa7e888


    # DYA Studio モジュール（すべて cormoran リポジトリ）
    - name: zmk-module-ble-management
      remote: cormoran
      revision: 851661c
    - name: zmk-module-battery-history
      remote: cormoran
      revision: 307755d
    - name: zmk-module-settings-rpc
      remote: cormoran
      revision: ad1c995
    - name: zmk-module-runtime-input-processor
      remote: NF-H
      revision: main   # 自分の修正コミットを含むブランチ名/ハッシュ
    - name: zmk-pmw3610-driver
      remote: badjeff
      revision: 5c5af40
    - name: zmk-rgbled-widget
      remote: caksoylar
      revision: 8756cb7
  self:
    path: config
```
